## west.yml
```yaml
manifest:
  self:
    path: app
  remotes:
    - name: nrf
      url-base: https://github.com/nrfconnect
    - name: zephyr
      url-base: https://github.com/zephyrproject-rtos
  projects:
    - name: sdk-nrf
      remote: nrf
      path: nrf
      revision: v2.6.1
      import:
        path-prefix: external
      clone-depth: 1
    - name: hal_stm32
      remote: zephyr
      revision: 89ef0a3383edebf661073073bcdf6e2836fe90ee
      path: external/modules/hal/stm32
      groups:
        - hal
```
