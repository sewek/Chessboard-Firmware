## CMakeLists.txt
```
cmake_minimum_required(VERSION 3.13.1)

# Print current directory
message("Current directory: ${CMAKE_CURRENT_SOURCE_DIR}")

list(APPEND BOARD_ROOT ${CMAKE_CURRENT_SOURCE_DIR}/..)
set(BOARD chessboard)
set(DTS_ROOT ${CMAKE_CURRENT_SOURCE_DIR})
set(mcuboot_CONFIG_BOOT_SIGNATURE_KEY_FILE \"${CMAKE_CURRENT_SOURCE_DIR}/../keys/root-rsa-2048.pem\")

set_property(GLOBAL PROPERTY CSTD c11)
find_package(Zephyr REQUIRED HINTS $ENV{ZEPHYR_BASE})

project(app)
target_sources(app PRIVATE src/main.cpp src/highlights.cpp src/timer.cpp)
add_subdirectory(src/tiles)
add_subdirectory(src/display)
add_subdirectory(src/screens)
add_subdirectory(src/buttons)

# Include directories
zephyr_include_directories(include)
target_include_directories(app PUBLIC include)

# Link chess_logic_lib to app
#add_subdirectory(../lib/chess_logic ${CMAKE_BINARY_DIR}/lib/chess_logic)
#target_link_libraries(app PUBLIC chess_logic_lib)
```

## Kconfig
```
menu "Zephyr"
source "Kconfig.zephyr"
endmenu

menu "Application Configuration"
rsource "src/display/Kconfig"
endmenu

module = APP
module-str = APP
source "subsys/logging/Kconfig.template.log_config"
```

## prj.conf
```kconfig
# Build
CONFIG_CPP=y
CONFIG_REQUIRES_FULL_LIBCPP=y
CONFIG_STD_CPP11=y
CONFIG_MINIMAL_LIBC=y

# Debug
CONFIG_DEBUG_COREDUMP=y
CONFIG_DEBUG_COREDUMP_MEMORY_DUMP_MIN=y
CONFIG_DEBUG_COREDUMP_BACKEND_LOGGING=y
CONFIG_DEBUG=y
CONFIG_DEBUG_INFO=y
CONFIG_LOG_BUFFER_SIZE=8192

# Bootloader
CONFIG_BOOTLOADER_MCUBOOT=y
CONFIG_MCUBOOT_GENERATE_CONFIRMED_IMAGE=y
CONFIG_DFU_MULTI_IMAGE_PACKAGE_BUILD=y
# CONFIG_SECURE_BOOT=y
CONFIG_PM_EXTERNAL_FLASH_MCUBOOT_SECONDARY=y
CONFIG_MCUBOOT_IMG_MANAGER=y
CONFIG_MCUMGR=y
CONFIG_STREAM_FLASH=y
CONFIG_FLASH_MAP=y
CONFIG_BASE64=y
CONFIG_SHELL=y
CONFIG_MCUBOOT_SHELL=y
CONFIG_SHELL_BACKEND_SERIAL=y
CONFIG_MCUMGR_TRANSPORT_SHELL=y
CONFIG_FLASH=y
CONFIG_IMG_MANAGER=y
CONFIG_MCUMGR_GRP_IMG=y
CONFIG_MCUMGR_GRP_OS=y
CONFIG_MCUMGR_TRANSPORT_BT=y

# Logging
CONFIG_LOG=y
CONFIG_UART_CONSOLE=n
CONFIG_RTT_CONSOLE=y
CONFIG_USE_SEGGER_RTT=y
CONFIG_SHELL_BACKEND_RTT=y
CONFIG_SHELL_BACKEND_SERIAL=y

# LVGL
CONFIG_LV_BUFFER_SIZE=16384
CONFIG_LV_Z_MEM_POOL_SIZE=16384
CONFIG_LV_Z_SHELL=y
CONFIG_MAIN_STACK_SIZE=8192
#CONFIG_DISPLAY_LOG_LEVEL_ERR=y
CONFIG_DISPLAY=y
CONFIG_LVGL=y
CONFIG_LV_COLOR_DEPTH_16=y
CONFIG_LV_Z_BITS_PER_PIXEL=24
CONFIG_LV_Z_BUFFER_ALLOC_STATIC=y
CONFIG_LV_MEM_CUSTOM=y
CONFIG_LV_USE_LOG=y
CONFIG_LV_USE_LABEL=y
CONFIG_LV_USE_BTN=y
CONFIG_LV_USE_IMG=y

CONFIG_LV_FONT_MONTSERRAT_16=y
CONFIG_LV_FONT_MONTSERRAT_26=y
CONFIG_LV_FONT_MONTSERRAT_36=y
CONFIG_LV_FONT_MONTSERRAT_46=y
CONFIG_LV_Z_VDB_SIZE=10
CONFIG_LV_LOG_LEVEL_NONE=y

# USB DFU
# CONFIG_USB_DEVICE_STACK=y
# CONFIG_USB_DEVICE_PRODUCT="Chessboard"
# CONFIG_USB_DEVICE_PID=0x0005
# CONFIG_USB_DFU_CLASS=y
# CONFIG_USB_DFU_ENABLE_UPLOAD=y
# CONFIG_FLASH=y
# CONFIG_FLASH_MAP=y
# CONFIG_STREAM_FLASH=y
# CONFIG_IMG_MANAGER=y
# CONFIG_LOG=y
# CONFIG_USB_DRIVER_LOG_LEVEL_ERR=y
# CONFIG_USB_DEVICE_LOG_LEVEL_ERR=y
# CONFIG_USB_DEVICE_INITIALIZE_AT_BOOT=n

# File System
CONFIG_FILE_SYSTEM=y
CONFIG_FILE_SYSTEM_LITTLEFS=y
CONFIG_PM_PARTITION_REGION_LITTLEFS_EXTERNAL=y

# Bluetooth
CONFIG_BT=y
CONFIG_BT_PERIPHERAL=y
CONFIG_BT_SMP=y
CONFIG_BT_GATT_CLIENT=y
CONFIG_BT_DEVICE_NAME="Chessboard"

CONFIG_BT_BUF_ACL_RX_SIZE=255
CONFIG_BT_BUF_ACL_TX_SIZE=251
CONFIG_BT_BUF_CMD_TX_SIZE=255
CONFIG_BT_BUF_EVT_DISCARDABLE_SIZE=255

CONFIG_BT_L2CAP_TX_MTU=252

# Tiles
CONFIG_SENSOR=y
CONFIG_TILES_SENSOR=y
CONFIG_TILES_SENSOR_TRIGGER=y

# Chess logic
CONFIG_CHESS_LIB_TEST=n
CONFIG_CHESS_LIB_DEBUG=y

# General
CONFIG_SHELL=y
CONFIG_MCUBOOT_SHELL=y
CONFIG_DEVICE_SHELL=y
CONFIG_HWINFO=y
CONFIG_HWINFO_SHELL=y
CONFIG_KERNEL_SHELL=y
CONFIG_GPIO_SHELL=y
CONFIG_ADC_SHELL=y
CONFIG_INPUT_SHELL=y
CONFIG_I2C_SHELL=y
CONFIG_SENSOR_SHELL=y
CONFIG_STATS_SHELL=y
CONFIG_FILE_SYSTEM_SHELL=y
CONFIG_FLASH_SHELL=y
CONFIG_FLASH_SHELL_TEST_COMMANDS=y
#CONFIG_BT_SHELL=y
CONFIG_PRINTK=y
CONFIG_RESET_ON_FATAL_ERROR=y
```

## src/main.cpp
```c
/**
 * @file main.cpp
 * @brief Main source file.
 */
#include <chess.h>
#include <chess_types.h>
#include <lvgl.h>
#include <zephyr/device.h>
#include <zephyr/drivers/display.h>
#include <zephyr/fs/fs.h>
#include <zephyr/fs/littlefs.h>
#include <zephyr/kernel.h>
#include <zephyr/logging/log.h>
#include <zephyr/storage/flash_map.h>
#include <zephyr/usb/usb_device.h>

#include "buttons.h"
#include "display.h"
#include "highlights.h"
#include "screens/screen_controller.h"
#include "tiles.h"
#include "timer.h"

#define CONFIG_BOARD "nRF52840"

LOG_MODULE_REGISTER(main);

#define ETC_PARTITION_NODE DT_NODELABEL(etc)
#define MNT_PARTITION_NODE DT_NODELABEL(mnt)

FS_FSTAB_DECLARE_ENTRY(ETC_PARTITION_NODE);
FS_FSTAB_DECLARE_ENTRY(MNT_PARTITION_NODE);

/* Timers */
Timer whiteTimer;
Timer blackTimer;

/* Buttons */
Buttons buttons;

/* Displays */
ScreenController screenController;

/* Tiles */
Tiles tiles;

/* Chess */
Chess chess;

void gameStartedCb() { LOG_INF("Game started"); }

void gameEndedCb() {
  LOG_INF("Game ended");
  ChessGameResult result = chess.getGameResult();

  whiteTimer.stop();
  blackTimer.stop();

  if (result == ChessGameResult::WhiteWins) {
    screenController.navigateTo(ChessColor::White, "win");
    screenController.navigateTo(ChessColor::Black, "lose");
  } else if (result == ChessGameResult::BlackWins) {
    screenController.navigateTo(ChessColor::White, "lose");
    screenController.navigateTo(ChessColor::Black, "win");
  } else {
    screenController.navigateTo(ChessColor::White, "draw2");
    screenController.navigateTo(ChessColor::Black, "draw2");
  }
}

void moveMadeCb(ChessMove *move) {
  char buff[7];
  move->toString(buff);
  buff[6] = '\0';
  LOG_INF("Move made: %s", buff);
}

void pieceHighlightedCb(ChessPosition *position, ChessHighlightType type) {
  printk("Highlighting piece\n");
  // char buff[3];
  // position->toString(buff);
  // buff[2] = '\0';
  // LOG_INF("Piece at %s highlighted", buff);

  tiles.setTileColor(position, getColor(type));
}

void pieceUnhighlightedCb(ChessPosition *position) {
  printk("Unhighlighting piece\n");
  // char buff[3];
  // position->toString(buff);
  // buff[2] = '\0';
  // LOG_INF("Piece at %s unhighlighted", buff);

  refreshTileColor(&tiles, position);
}

void chessCastlingCb(ChessColor color) {
  screenController.navigateTo(color, "castling");
}

void chessPromotionCb(ChessColor color) {
  screenController.navigateTo(color, "promotion");
}

void chessEnPassantCb(ChessColor color) {
  screenController.navigateTo(color, "en_passant");
}

void chessErrorCb(ChessColor color) {
  screenController.navigateTo(color, "error");
}

int main() {
  LOG_INF("build time: " __DATE__ " " __TIME__ "");
  LOG_INF("board: %s", CONFIG_BOARD);

  int ret;

  chess.addListener(ChessEventType::GameStarted, gameStartedCb);
  chess.addListener(ChessEventType::GameEnded, gameEndedCb);
  chess.addListener(ChessEventType::MoveMade, moveMadeCb);
  chess.addListener(ChessEventType::HighlightSquare, pieceHighlightedCb);
  chess.addListener(ChessEventType::UnhighlightSquare, pieceUnhighlightedCb);
  chess.addListener(ChessEventType::Castling, chessCastlingCb);
  chess.addListener(ChessEventType::Promotion, chessPromotionCb);
  chess.addListener(ChessEventType::EnPassant, chessEnPassantCb);
  chess.addListener(ChessEventType::Error, chessErrorCb);
  tiles.setTriggerHandler(tilesChangeCallback);

  LOG_INF("Initializing buttons");
  ret = buttons.init();
  if (ret < 0) {
    LOG_ERR("Failed to initialize buttons");
    return ret;
  }
  LOG_INF("Buttons initialized");

  LOG_INF("Initializing tiles");
  ret = tiles.init();
  if (ret < 0) {
    LOG_ERR("Failed to initialize tiles");
    return ret;
  }
  LOG_INF("Tiles initialized");

  refreshTilesColor(&tiles);

  LOG_INF("Initializing screen controller");
  ret = screenController.init();
  if (ret < 0) {
    LOG_ERR("Failed to initialize screen controller");
    return ret;
  }
  LOG_INF("Screen controller initialized");

  Tile *tile = nullptr;
  for (int i = 0; i < 64; i++) {
    tile = &tiles.tiles[i];
    if (tile->dev == nullptr) {
      continue;
    }

    chess.notifyTileAction(&tile->position, tile->state
                                                ? ChessTileActionType::PutDown
                                                : ChessTileActionType::PickUp);
  }

  while (true) {
    // Refresh the screen
    handleTilesAction();
    screenController.run();

    k_sleep(K_MSEC(50));
  }

  return 0;
}
```

## include/button.h
```c
/**
 * @file button.h
 * @brief
 */

#ifndef BUTTON_H
#define BUTTON_H

#include <chess_types.h>
#include <inttypes.h>
#include <zephyr/drivers/gpio.h>

enum class ButtonType {
  Up = 0,
  Down,
  Accept,
  Cancel,
  Timer,
};

class Button {
 public:
  struct gpio_dt_spec* spec = nullptr;
  struct gpio_callback* callback = nullptr;
  ChessColor color = ChessColor::White;
  ButtonType type = ButtonType::Up;

  Button() = default;
  Button(struct gpio_dt_spec* spec, struct gpio_callback* callback,
         ChessColor color, ButtonType type);
  ~Button();

  bool isPressed();

  void press() { this->pressedCount++; }

 private:
  uint16_t pressedCount = 0;
};

#endif  // BUTTON_H
```

## include/buttons.h
```c
/**
 * @file buttons.h
 * @brief This file contains the declaration of the functions that are used to
 * handle the buttons.
 */

#ifndef BUTTONS_H
#define BUTTONS_H

#include <zephyr/device.h>
#include <zephyr/devicetree.h>

#include "button.h"

#define BUTTONS_COUNT 10

class Buttons {
 public:
  Button buttons[BUTTONS_COUNT];

  Buttons() = default;
  ~Buttons();

  /**
   * @brief This function is used to initialize the buttons.
   */
  int init();

  Button *getButton(ChessColor color, ButtonType type);
  Button *getButton(uint8_t index);
  Button *getButton(struct gpio_dt_spec *spec);
  Button *getButton(struct gpio_callback *callback);

  bool isPressed(ChessColor color, ButtonType type);

 private:
  struct gpio_dt_spec buttons_spec[BUTTONS_COUNT] = {
      GPIO_DT_SPEC_GET(DT_ALIAS(btn0), gpios),
      GPIO_DT_SPEC_GET(DT_ALIAS(btn1), gpios),
      GPIO_DT_SPEC_GET(DT_ALIAS(btn2), gpios),
      GPIO_DT_SPEC_GET(DT_ALIAS(btn3), gpios),
      GPIO_DT_SPEC_GET(DT_ALIAS(btn4), gpios),
      GPIO_DT_SPEC_GET(DT_ALIAS(btn5), gpios),
      GPIO_DT_SPEC_GET(DT_ALIAS(btn6), gpios),
      GPIO_DT_SPEC_GET(DT_ALIAS(btn7), gpios),
      GPIO_DT_SPEC_GET(DT_ALIAS(btn8), gpios),
      GPIO_DT_SPEC_GET(DT_ALIAS(btn9), gpios),
  };
  struct gpio_callback buttons_cb[BUTTONS_COUNT];
};

void buttonPressedCallback(const struct device *dev, struct gpio_callback *cb,
                           uint32_t pins);

#endif  // BUTTONS_H
```

## include/display.h
```c
/**
 * @file display.h
 * @brief Display driver API.
 */

#ifndef DISPLAY_H
#define DISPLAY_H

#include <lvgl.h>
#include <zephyr/device.h>
#include <zephyr/kernel.h>
#include <zephyr/logging/log.h>

#include "lvgl_display.h"

class Display {
 public:
  Display(const struct device *dev, uint32_t width, uint32_t height,
          uint8_t bits_per_pixel)
      : dev(dev),
        width(width),
        height(height),
        bits_per_pixel(bits_per_pixel),
        nbr_pixels(this->buffer_size / (bits_per_pixel / 8)) {}
  ~Display() { lv_disp_remove(this->display); }

  const struct device *dev;
  uint32_t width;
  uint32_t height;
  uint32_t buffer_size = CONFIG_LV_BUFFER_SIZE;
  uint8_t bits_per_pixel;
  uint32_t nbr_pixels;
  lv_disp_drv_t driver;
  lv_disp_draw_buf_t display_buf;
  struct lvgl_disp_data data = {
      .blanking_on = false,
  };
  lv_disp_t *display = nullptr;

  int init();

  void setAsActive() { lv_disp_set_default(this->display); }

 private:
  uint8_t buf0[CONFIG_LV_BUFFER_SIZE];
#ifdef CONFIG_LV_Z_DOUBLE_VDB
  uint8_t buf1[CONFIG_LV_BUFFER_SIZE];
#endif

  int allocateBuffers();
};

#endif  // DISPLAY_H
```

## include/highlights.h
```c
#ifndef HIGHLIGHTS_H
#define HIGHLIGHTS_H

#include <chess_types.h>

#include "tiles.h"

#define NORMAL_MOVE_COLOR 0xbadc58
#define CAPTURE_MOVE_COLOR 0xc0392b
#define CHECK_COLOR 0xf1c40f
#define CHECKMATE_COLOR 0xc0392b
#define INFO_COLOR 0x9b59b6
#define ERROR_COLOR 0x9b59b6

#define LIGHT_COLOR 0x000000
#define DARK_COLOR 0x3498db

uint32_t rgbToHex(uint32_t rgb);

uint32_t getColor(ChessHighlightType type);

uint32_t getTileLightColor();

uint32_t getTileDarkColor();

void refreshTilesColor(Tiles* tiles);

void refreshTileColor(Tiles* tiles, ChessPosition* position);

#endif  // HIGHLIGHTS_H
```

## include/lvgl_display.h
```c
/*
 * Copyright (c) 2019 Jan Van Winkel <jan.van_winkel@dxplore.eu>
 * Copyright 2023 NXP
 *
 * SPDX-License-Identifier: Apache-2.0
 */

#ifndef ZEPHYR_MODULES_LVGL_DISPLAY_H_
#define ZEPHYR_MODULES_LVGL_DISPLAY_H_

#include <lvgl.h>
#include <zephyr/drivers/display.h>

#ifdef __cplusplus
extern "C" {
#endif

struct lvgl_disp_data {
  const struct device *display_dev;
  struct display_capabilities cap;
  bool blanking_on;
};

struct lvgl_display_flush {
  lv_disp_drv_t *disp_drv;
  uint16_t x;
  uint16_t y;
  struct display_buffer_descriptor desc;
  void *buf;
};

void lvgl_flush_cb_mono(lv_disp_drv_t *disp_drv, const lv_area_t *area,
                        lv_color_t *color_p);
void lvgl_flush_cb_16bit(lv_disp_drv_t *disp_drv, const lv_area_t *area,
                         lv_color_t *color_p);
void lvgl_flush_cb_24bit(lv_disp_drv_t *disp_drv, const lv_area_t *area,
                         lv_color_t *color_p);
void lvgl_flush_cb_32bit(lv_disp_drv_t *disp_drv, const lv_area_t *area,
                         lv_color_t *color_p);

void lvgl_set_px_cb_mono(lv_disp_drv_t *disp_drv, uint8_t *buf,
                         lv_coord_t buf_w, lv_coord_t x, lv_coord_t y,
                         lv_color_t color, lv_opa_t opa);
void lvgl_set_px_cb_16bit(lv_disp_drv_t *disp_drv, uint8_t *buf,
                          lv_coord_t buf_w, lv_coord_t x, lv_coord_t y,
                          lv_color_t color, lv_opa_t opa);
void lvgl_set_px_cb_24bit(lv_disp_drv_t *disp_drv, uint8_t *buf,
                          lv_coord_t buf_w, lv_coord_t x, lv_coord_t y,
                          lv_color_t color, lv_opa_t opa);
void lvgl_set_px_cb_32bit(lv_disp_drv_t *disp_drv, uint8_t *buf,
                          lv_coord_t buf_w, lv_coord_t x, lv_coord_t y,
                          lv_color_t color, lv_opa_t opa);

void lvgl_rounder_cb_mono(lv_disp_drv_t *disp_drv, lv_area_t *area);

int set_lvgl_rendering_cb(lv_disp_drv_t *disp_drv);

void lvgl_flush_display(struct lvgl_display_flush *request);

#ifdef __cplusplus
}
#endif

#endif /* ZEPHYR_MODULES_LVGL_DISPLAY_H_ */
```

## include/tile.h
```c
/**
 * @file tile.h
 * @brief Chessboard Tile representation
 */

#ifndef TILE_H
#define TILE_H

#include <chess_position.h>
#include <inttypes.h>
#include <zephyr/device.h>

/**
 * @brief Representation of single chessboard tile with its position, current
 * color and state
 */
class Tile {
 public:
  ChessPosition position = ChessPosition(0, 0);
  uint32_t color;
  uint8_t state;
  struct device *dev;
  uint8_t channel;

  Tile();
  Tile(ChessPosition *position, uint32_t color, uint8_t state,
       struct device *dev, uint8_t channel);
  ~Tile();
};

#endif  // TILE_H
```

## include/tiles.h
```c
/**
 * @file tiles.h
 * @brief Chessboard Tiles driver abstraction
 */

#ifndef TILES_H
#define TILES_H

#include <app/drivers/sensor/tiles.h>
#include <chess_position.h>
#include <chess_types.h>
#include <tile.h>
#include <zephyr/device.h>
#include <zephyr/devicetree.h>
#include <zephyr/drivers/sensor.h>

#define DT_DRV_COMPAT chess_tiles
#define TILES_REF(node_id) DEVICE_DT_GET(node_id),

using TileChangeCallback = void (*)(Tile *tile, ChessTileActionType action);

/**
 * @brief Chessboard Tiles driver abstraction
 */
class Tiles {
 public:
  Tiles();
  ~Tiles();

  /**
   * @brief Initialize the tiles driver
   * @return 0 on success, negative error code on failure
   */
  int init();

  /**
   * @brief Get list of tiles on the chessboard
   * @return List of tiles
   */
  Tile *getTiles();

  /**
   * @brief Get the tile at the given position
   * @param position The position of the tile
   * @return The tile at the given position
   */
  Tile *getTile(ChessPosition *position);

  /**
   * @brief Get the tiles count
   * @return The tiles count
   */
  int getTilesCount() { return tiles_count; }

  /**
   * @brief Set tile color
   * @param position The position of the tile
   * @param color The color to set
   * @return 0 on success, negative error code on failure
   */
  int setTileColor(ChessPosition *position, uint32_t color);

  /**
   * @brief Set tile position
   * @param position The position of the tile
   * @param new_position The new position to set
   * @return 0 on success, negative error code on failure
   */
  int setTilePosition(ChessPosition *position, ChessPosition *new_position);

  /**
   * @brief Set tile threshold
   * @param position The position of the tile
   * @param threshold The threshold to set
   * @return 0 on success, negative error code on failure
   */
  int setTileThreshold(ChessPosition *position, uint16_t threshold);

  /**
   * @brief Set tile interval
   * @param position The position of the tile
   * @param interval The interval to set
   * @return 0 on success, negative error code on failure
   */
  int setTileInterval(ChessPosition *position, uint8_t interval);

  /**
   * @brief Set trigger handler
   * @param handler The trigger handler to set
   */
  void setTriggerHandler(sensor_trigger_handler_t handler);

  const struct device *tiles_dev[DT_NUM_INST_STATUS_OKAY(DT_DRV_COMPAT)] = {
      DT_FOREACH_STATUS_OKAY(DT_DRV_COMPAT, TILES_REF)};
  int tiles_count = ARRAY_SIZE(tiles_dev);
  const struct sensor_trigger trigger = {
      .type = SENSOR_TRIG_DATA_READY,
      .chan = static_cast<enum sensor_channel>(SENSOR_CHAN_TILES_STATE),
  };
  Tile tiles[64];

  static uint8_t positionToIndex(ChessPosition *position);
  static ChessPosition indexToPosition(uint8_t index);

 private:
  sensor_trigger_handler_t trigger_handler = nullptr;
};

void tilesChangeCallback(const struct device *dev,
                         const struct sensor_trigger *trg);
void tilesTriggerHandler(void *arg1, void *arg2, void *arg3);

void handleTilesAction();

#endif  // TILES_H
```

## include/timer.h
```c
#ifndef TIMER_H
#define TIMER_H

#include <chess_types.h>

/**
 * @brief This class represents the timer of the chess game
 */
class Timer {
 public:
  Timer();
  ~Timer();

  /**
   * @brief Start the timer
   * @return 0 on success, negative error code on failure
   */
  int start();

  /**
   * @brief Stop the timer
   * @return 0 on success, negative error code on failure
   */
  int stop();

  /**
   * @brief Is the timer stopped
   * @return True if the timer is stopped, false otherwise
   */
  bool isStopped() { return this->stopped; }

  /**
   * @brief Is the timer paused
   * @return True if the timer is paused, false otherwise
   */
  bool isPaused() { return this->paused; }

  /**
   * @brief Pause the timer
   * @return 0 on success, negative error code on failure
   */
  int pause();

  /**
   * @brief Resume the timer
   * @return 0 on success, negative error code on failure
   */
  int resume();

  /**
   * @brief Get the elapsed time
   * @return The elapsed time
   */
  uint32_t getElapsedTime();

  /**
   * @brief Set the elapsed time
   * @param time The time to set
   */
  void setElapsedTime(uint32_t time);

  /**
   * @brief Get the elapsed time as a string
   * @return The elapsed time as a string
   */
  void toString(char* buff);

 private:
  char buff[8];
  uint32_t startTime = 0;
  uint32_t elapsedTime = 0;
  bool stopped = true;
  bool paused = false;
};

#endif  // TIMER_H
```

## src/highlights.cpp
```c
#include "highlights.h"

#include <zephyr/logging/log.h>

LOG_MODULE_REGISTER(highlights, LOG_LEVEL_DBG);

uint32_t rgbToHex(uint32_t rgb) {
  return (rgb >> 16) | ((rgb & 0x00FF00) | (rgb << 16));
}

uint32_t getColor(ChessHighlightType type) {
  switch (type) {
    case ChessHighlightType::NormalMove:
      return rgbToHex(NORMAL_MOVE_COLOR);
    case ChessHighlightType::CaptureMove:
      return rgbToHex(CAPTURE_MOVE_COLOR);
    case ChessHighlightType::Check:
      return rgbToHex(CHECK_COLOR);
    case ChessHighlightType::Checkmate:
      return rgbToHex(CHECKMATE_COLOR);
    case ChessHighlightType::Error:
      return rgbToHex(ERROR_COLOR);
    case ChessHighlightType::Info:
      return rgbToHex(INFO_COLOR);
    default:
      return rgbToHex(0x000000);
  }
}

uint32_t getTileLightColor() { return rgbToHex(LIGHT_COLOR); }

uint32_t getTileDarkColor() { return rgbToHex(DARK_COLOR); }

void refreshTilesColor(Tiles* tiles) {
  uint8_t file = 0;
  uint8_t rank = 0;
  Tile* tile = nullptr;
  for (int i = 0; i < 64; i++) {
    tile = &tiles->getTiles()[i];

    if (tile->dev == nullptr) {
      // LOG_ERR("No device found for tile %d", i);
      continue;
    }

    file = tile->position.getFile();
    rank = tile->position.getRank();

    if ((file % 2) == (rank % 2)) {
      tiles->setTileColor(&tile->position, getTileDarkColor());
      // LOG_INF("Tile %d is dark", i);
    } else {
      tiles->setTileColor(&tile->position, getTileLightColor());
      // LOG_INF("Tile %d is light", i);
    }
  }
}

void refreshTileColor(Tiles* tiles, ChessPosition* position) {
  Tile* tile = tiles->getTile(position);
  if (tile == nullptr) {
    return;
  }

  uint8_t file = position->getFile();
  uint8_t rank = position->getRank();

  if ((file % 2) == (rank % 2)) {
    tiles->setTileColor(position, getTileDarkColor());
    // LOG_INF("Tile %d is dark", i);
  } else {
    tiles->setTileColor(position, getTileLightColor());
    // LOG_INF("Tile %d is light", i);
  }
}
```

## src/timer.cpp
```c
/**
 * @file timer.cpp
 * @brief This file contains the implementation of the Timer class
 */

#include "timer.h"

#include <zephyr/kernel.h>

Timer::Timer() {}

Timer::~Timer() {}

int Timer::start() {
  this->startTime = k_uptime_get_32();
  this->stopped = false;
  return 0;
}

int Timer::stop() {
  this->elapsedTime = 0;
  this->startTime = 0;
  this->stopped = true;
  return 0;
}

int Timer::pause() {
  this->elapsedTime = this->getElapsedTime();
  this->paused = true;
  return 0;
}

int Timer::resume() {
  this->startTime = k_uptime_get_32();
  this->paused = false;
  return 0;
}

uint32_t Timer::getElapsedTime() {
  if (this->stopped) return this->elapsedTime;
  if (this->paused) return this->elapsedTime;
  int time =
      (int)(this->elapsedTime - ((k_uptime_get_32() - this->startTime) / 1000));
  return time < 0 ? 0 : time;
}

void Timer::setElapsedTime(uint32_t time) { this->elapsedTime = time; }

void Timer::toString(char* buff) {
  uint32_t time = this->getElapsedTime();
  uint32_t minutes = time / 60;
  uint32_t seconds = time % 60;
  snprintf(buff, 8, "%02d:%02d", minutes, seconds);
  buff[7] = '\0';
}
```
