## boards/arm/chessboard/Kconfig.defconfig
```kconfig
if BOARD_CHESSBOARD

config BOARD
	default "chessboard"

config BT_CTLR
	default BT

endif # BOARD_CHESSBOARD
```

## boards/arm/chessboard/chessboard_defconfig
```kconfig
# SoC
CONFIG_SOC_SERIES_NRF52X=y
CONFIG_SOC_NRF52840_QIAA=y
CONFIG_BOARD_CHESSBOARD=y

# Flash
CONFIG_NORDIC_QSPI_NOR=y
CONFIG_NORDIC_QSPI_NOR_FLASH_LAYOUT_PAGE_SIZE=4096
CONFIG_NORDIC_QSPI_NOR_STACK_WRITE_BUFFER_SIZE=4

# Memory
CONFIG_HEAP_MEM_POOL_SIZE=4096
CONFIG_MAIN_STACK_SIZE=2048

# Enable MPU
CONFIG_ARM_MPU=y

# Enable hardware stack protection
CONFIG_HW_STACK_PROTECTION=y

# Enable RTT
CONFIG_USE_SEGGER_RTT=y

# Enable ADC
CONFIG_ADC=y

# Enable GPIO
CONFIG_GPIO=y

# Enable SPI
CONFIG_SPI=y

# Enable I2C
CONFIG_I2C=y

# Enable uart driver
CONFIG_SERIAL=y

# Enable console
CONFIG_CONSOLE=y
CONFIG_UART_CONSOLE=y

# Display
CONFIG_DISPLAY=y
CONFIG_ILI9488=y
CONFIG_DISPLAY_LOG_LEVEL_DBG=y
```

## drivers/sensor/chessboard_tiles/Kconfig
```kconfig
config CHESSBOARD_TILES_SENSOR
      bool "Enable chessboard tiles sensor"
      default n
      select I2C
      help
         Enable support for the chessboard tiles sensor.
```

## drivers/sensor/tiles/Kconfig
```kconfig
config TILES_SENSOR
      bool "Enable chessboard tiles sensor"
      default n
      select I2C
      help
         Enable support for the chessboard tiles sensor.

if TILES_SENSOR

menuconfig TILES_SENSOR_TRIGGER
      bool "Enable trigger support"
      default n
      help
         Enable support for the chessboard tiles sensor trigger.

      config TILES_SENSOR_TRIGGER_THREAD_PRIORITY
            int "Thread priority"
            default 10
            depends on TILES_SENSOR_TRIGGER
            help
               Priority for the trigger thread.

      config TILES_SENSOR_TRIGGER_THREAD_STACK_SIZE
            int "Thread stack size"
            default 512
            depends on TILES_SENSOR_TRIGGER
            help
               Stack size for the trigger thread.

      config TILES_SENSOR_TRIGGER_THREAD_PERIOD_MS
            int "Thread period"
            default 2
            depends on TILES_SENSOR_TRIGGER
            help
               Period in milliseconds for the trigger thread.

      config TILES_SENSOR_TRIGGER_INTERVAL_MS
            int "Trigger interval"
            default 10
            depends on TILES_SENSOR_TRIGGER
            help
               Interval in milliseconds between trigger events.

endif # CHESSBOARD_TILES_SENSOR
```

## dts/bindings/chess,tiles.yaml
```yaml
description: Chessboard tiles board containing 2x2 tiles

compatible: "chess,tiles"

include: i2c-device.yaml
```

## lib/chess_logic/Kconfig
```kconfig
menu "Chess library configuration"

config CHESS_LIB_DEBUG
   bool "Enable chess library debug"
   default n
   help
      Enable debug messages in the chess library.

config CHESS_LIB_TEST
   bool "Enable chess library tests"
   default n
   help
      Enable test version without checking for correct positions of pieces.

endmenu
```
